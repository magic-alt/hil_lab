/dts-v1/;
/plugin/;

/ {
    fragment@0 {
        target-path = "/";
        __overlay__ {
            hil_axi_uio: hil-axi@43c00000 {
                compatible = "generic-uio";
                reg = <0x43c00000 0x1000>;
                status = "okay";
            };
        };
    };
};
