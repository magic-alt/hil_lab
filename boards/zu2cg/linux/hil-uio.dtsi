/dts-v1/;
/plugin/;

/ {
    fragment@0 {
        target-path = "/";
        __overlay__ {
            hil_axi_uio: hil-axi@a0000000 {
                compatible = "generic-uio";
                reg = <0x0 0xa0000000 0x0 0x1000>;
                status = "okay";
            };
        };
    };
};
